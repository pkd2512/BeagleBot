/dts-v1/;

/ {
	compatible = "ti,beaglebone", "ti,beaglebone-black";
	part-number = "GPIO-Enable";
	version = "00A0";

	fragment@0 {
		target = <0xdeadbeef>;

		__overlay__ {

			GPIO-Enable {
				pinctrl-single,pins = <
				/* Configuring P8 pins P8_11 to P8_18 as GPIO Pulldown Input/Output Pins*/
				0x034 0x27
				0x030 0x07
				0x024 0x27
				0x028 0x07
				0x03c 0x27
				0x038 0x07
				0x02c 0x27
				0x08c 0x07
				/* Enabling Timer 4 in input mode operation */
				0x090 0x32			
				/* Configuring P9 pins P9_11 to P9_18 as GPIO Pulldown Input/Output Pins*/
				0x070 0x27
				0x078 0x07
				0x074 0x27
				0x048 0x07
				0x040 0x27
				0x04c 0x07
				0x15c 0x27
				0x158 0x07
                               /* OUTPUT  GPIO(mode7) 0x07 pulldown, 0x17 pullup, 0x?f no pullup/down */
			       /* INPUT   GPIO(mode7) 0x27 pulldown, 0x37 pullup, 0x?f no pullup/down */
								
			        
				>;
				linux,phandle = <0x1>;
				phandle = <0x1>;
			};
		};
	};

	fragment@1 {
		target = <0xdeadbeef>;

		__overlay__ {

			helper {
				compatible = "bone-pinmux-helper";
				pinctrl-names = "default";
				pinctrl-0 = <0x1>;
				status = "okay";
				linux,phandle = <0x2>;
				phandle = <0x2>;
			};
		};
	};

	__symbols__ {
		pinctrl_test = "/fragment@0/__overlay__/GPIO-Enable";
		test_helper = "/fragment@1/__overlay__/helper";
	};

	__fixups__ {
		am33xx_pinmux = "/fragment@0:target:0";
		ocp = "/fragment@1:target:0";
	};

	__local_fixups__ {
		fixup = "/fragment@1/__overlay__/helper:pinctrl-0:0";
	};
};

			
